// SPDX-License-Identifier: GPL-2.0
/*
 * Device Tree Source for NXP SimTemp Virtual Temperature Sensor
 *
 * Copyright (C) 2025 NXP Semiconductors
 */

/ {
	simtemp0: simtemp@0 {
		compatible = "nxp,simtemp";
		sampling-ms = <100>;		/* 100ms sampling period */
		threshold-mC = <45000>;		/* 45.0°C threshold */
		status = "okay";
	};
};
